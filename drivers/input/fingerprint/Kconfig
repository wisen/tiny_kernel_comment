## drivers/input/fingerprint/Kconfig
```kconfig
#
#Fingerprint modify by rulei.zhou
#
menu "Fingerprint support"
	depends on INPUT

config MTK_FINGERPRINT_SUPPORT
	bool "Mediatek Fingerprint"
	default n
	---help---
	Fingerprint mtk driver enable/disable in the kernel.
	Say Y here if you want to use mediatek fingerprint driver,
	fingerprint driver will support fingerprint function

if MTK_FINGERPRINT_SUPPORT


config FPC_FINGERPRINT
	bool "FPC Fingerprint"
	default n
	---help---
	FPC fingerprint FPC's 102x/104x device.
config GOODIX_FINGERPRINT_GX556
	bool "Goodix Fingerprint"
	default n
	---help---
	Goodix Fingerprint chip GX556 REE driver
config FINGERPRINT_SW9251
	bool "sunwave Fingerprint"
	default n
	---help---
	sunwave Fingerprint chip GX556 REE driver

endif
endmenu
```

## drivers/misc/mediatek/accelerometer/mxc400x-new/Kconfig
```kconfig
config MTK_MXC405XC
	bool "MTK_MXC400X_Q35 for MediaTek package"
	default n
	help
	  It support different accelerometer sensor.
          If this option is set,
	  it will support
          MTK_MXC400X_Q35 Accelerometer.

config MXC400X_Q35_LOWPASS
	bool "MTK_MXC400X_Q35_LOWPASS for Mediatek package"
	default n
	help
	Say Y here if you have MTK_MXC400X_Q35 touch panel MXC400X_Q35_LOWPASS.

	If unsure, say N.

	To compile this dirver as a module, choose M here: the
	module will be called.

config CUSTOM_KERNEL_SENSORHUB
	bool "MTK_MXC400X_Q35 for Mediatek package"
	default n
	help
	Say Y here if you have MTK_BMA222E_NEW touch panel CUSTOM_KERNEL_SENSORHUB.

	If unsure, say N.

	To compile this dirver as a module, choose M here: the
	module will be called.
```

## drivers/misc/mediatek/aw9136/Kconfig
```kconfig
config MTK_AW9136
	bool "Enable MTK AW9136 information Driver"
	default y
	help
	  Boot information driver includes specific information.
```

## drivers/misc/mediatek/fingerprint/Kconfig
```kconfig
#
#Fingerprint
#
menu "Reallytek Fingerprint support"
	depends on MEDIATEK_SOLUTION

config RLK_FINGERPRINT_SUPPORT
	bool "Reallytek Fingerprint"
	default n
	---help---
	Fingerprint mtk driver enable/disable in the kernel.
	Say Y here if you want to use mediatek fingerprint driver,
	fingerprint driver will support fingerprint function in REE,
	it supports FPC's 102x/104x device.

if RLK_FINGERPRINT_SUPPORT
config FPC_FINGERPRINT
	bool "FPC Fingerprint"
	default n
	---help---
	FPC fingerprint FPC's 102x/104x device.
config GOODIX_FINGERPRINT_GF3118
	bool "Goodix Fingerprint"
	default n
	---help---
	Goodix Fingerprint chip /GF318/GF316M/GF318M TEE driver
config RLK_FINGERPRINT_A121N
	bool "AFS fingerprint"
	default n
	---help---
	AFS Fingerprint chip
config RLK_FINGERPRINT_ELAN
	bool "ELAN fingerprint"
	default n
	---help---
	ELAN Fingerprint chip
config GOODIX_FINGERPRINT_GF368M
	bool "Goodix Fingerprint"
	default n
	---help---
	Goodix Fingerprint chip /GF318/GF316M/GF318M TEE driver
endif
endmenu
```
